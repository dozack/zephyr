## boards/arm/ti_launchxl2_tms570lc4357/Kconfig.board
```kconfig
# Texas Instruments Hercules MCU Family
#
# Copyright (c) 2023 Texas Instruments Incorporated
# Copyright (C) 2023 Zoltan Dolensky
#
# SPDX-License-Identifier: Apache-2.0

config BOARD_TI_LAUNCHXL2_TMS570LC4357
	bool "TI Hercules TMS570LC43x LaunchPad Development Kit"
	depends on SOC_TI_TMS570LC4357
```

## boards/arm/ti_launchxl2_tms570lc4357/Kconfig.defconfig
```kconfig
# Texas Instruments Hercules MCU Family
#
# Copyright (c) 2023 Texas Instruments Incorporated
# Copyright (C) 2023 Zoltan Dolensky
#
# SPDX-License-Identifier: Apache-2.0

if BOARD_TI_LAUNCHXL2_TMS570LC4357

config BOARD
        default "TI_LAUNCHXL2_TMS570LC4357"

endif
```

## soc/arm/ti_hercules/Kconfig
```kconfig
# Texas Instruments Hercules MCU Family
#
# Copyright (c) 2023 Texas Instruments Incorporated
# Copyright (C) 2023 Zoltan Dolensky
#
# SPDX-License-Identifier: Apache-2.0

config SOC_FAMILY_TI_HERCULES
	bool

if SOC_FAMILY_TI_HERCULES

config SOC_FAMILY
	string
	default "ti_hercules"

source "soc/arm/ti_hercules/*/Kconfig.soc"

endif
```

## soc/arm/ti_hercules/Kconfig.defconfig
```kconfig
# Texas Instruments Hercules MCU Family
#
# Copyright (c) 2023 Texas Instruments Incorporated
# Copyright (C) 2023 Zoltan Dolensky
#
# SPDX-License-Identifier: Apache-2.0

source "soc/arm/ti_hercules/*/Kconfig.defconfig.series"
```

## soc/arm/ti_hercules/tms570lc43x/Kconfig.defconfig
```kconfig
# Texas Instruments Hercules MCU Family
#
# Copyright (c) 2023 Texas Instruments Incorporated
# Copyright (C) 2023 Zoltan Dolensky
#
# SPDX-License-Identifier: Apache-2.0

if SOC_TI_TMS570LC4357

config SOC
	default "TMS570LC4357"

endif
```

## soc/arm/ti_hercules/tms570lc43x/Kconfig.defconfig.series
```kconfig
# Texas Instruments Hercules MCU Family
#
# Copyright (c) 2023 Texas Instruments Incorporated
# Copyright (C) 2023 Zoltan Dolensky
#
# SPDX-License-Identifier: Apache-2.0

if SOC_SERIES_TI_TMS570LC43X

source "soc/arm/ti_tms570lc43x/Kconfig.defconfig.tms570lc43*"

config SOC_SERIES
	default "TMS570LC43x"

config NUM_IRQS
	default 128

config SYS_CLOCK_HW_CYCLES_PER_SEC
	default 100000000

config SYS_CLOCK_TICKS_PER_SEC
	default 1000

config KERNEL_ENTRY
	default "_vector_table"

endif
```

## soc/arm/ti_hercules/tms570lc43x/Kconfig.defconfig.tms570lc4357
```kconfig
# Texas Instruments Hercules MCU Family
#
# Copyright (c) 2023 Texas Instruments Incorporated
# Copyright (C) 2023 Zoltan Dolensky
#
# SPDX-License-Identifier: Apache-2.0

config SOC
	default "TMS570LC4357"
	depends on SOC_TI_TMS570LC4357
```

## soc/arm/ti_hercules/tms570lc43x/Kconfig.series
```kconfig
# Texas Instruments Hercules MCU Family
#
# Copyright (c) 2023 Texas Instruments Incorporated
# Copyright (C) 2023 Zoltan Dolensky
#
# SPDX-License-Identifier: Apache-2.0

config SOC_SERIES_TI_TMS570LC43X
	bool "TI Hercules TMS570LC43x SoC series"
	select ARM
	select SOC_FAMILY_TI_HERCULES
	select CPU_CORTEX_R5
	select ARM_CUSTOM_INTERRUPT_CONTROLLER
	select VIM
	help
	  Enable support for the TI Hercules TMS570LC43x SoC series
```

## soc/arm/ti_hercules/tms570lc43x/Kconfig.soc
```kconfig
# Texas Instruments Hercules MCU Family
#
# Copyright (c) 2023 Texas Instruments Incorporated
# Copyright (C) 2023 Zoltan Dolensky
#
# SPDX-License-Identifier: Apache-2.0

choice
	prompt "TI Hercules TMS570LC43x SoC"
	depends on SOC_SERIES_TI_TMS570LC43X

config SOC_TI_TMS570LC4357
	bool "TI TMS570LC4357"

endchoice
```

## subsys/canbus/j1939/Kconfig
```kconfig
#
# Copyright (c) 2024 Zoltan Dolensky
#
# SPDX-License-Identifier: Apache-2.0
#

menuconfig J1939
	bool "SAE J1939 protocol"
	depends on CAN
	help
	  Enable SAE J1939 support for CAN

if J1939

module = J1939
module-str = J1939
source "subsys/logging/Kconfig.template.log_config"

endif # J1939
```
